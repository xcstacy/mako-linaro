## drivers/media/video/samsung/mali_r3p0_lsi/Kconfig
```kconfig
#
## S3C Multimedia Mali configuration
##
#
# For Mali
config MALI_R3P0_LSI
	tristate "Enable MALI_R3P0_LSI integration"
	depends on VIDEO_SAMSUNG
	default m
	---help---
                This enables MALI integration in the multimedia device driver
```
